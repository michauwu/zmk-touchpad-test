## boards/shields/xiao_tps65/Kconfig.defconfig
```kconfig
if SHIELD_XIAO_TPS65

config ZMK_KEYBOARD_NAME
    default "XIAO TPS65"

config ZMK_POINTING
    default y

endif
```

## config/west.yml
```yaml
manifest:
  remotes:
    - name: zmkfirmware
      url-base: https://github.com/zmkfirmware
    - name: geeksville
      url-base: https://github.com/geeksville
  projects:
    - name: zmk
      remote: zmkfirmware
      revision: v0.3
      import: app/west.yml
    - name: zmk_driver_azoteq
      remote: geeksville
      revision: 66d510249d139569a4060c35bd78c6a2159f83ed
  self:
    path: config
```
